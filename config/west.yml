## config/west.yml
```yaml
manifest:
  defaults:
    revision: v0.3
  remotes:
    - name: zmkfirmware
      url-base: https://github.com/zmkfirmware
    - name: myfork
      url-base: https://github.com/Nebq29
  projects:
    - name: zmk
      remote: myfork
      revision: v0.3-branch
      import: app/west.yml
  self:
    path: config
```
